## Software/nrf7002-bsd-sockets-example-main/build/Kconfig/Kconfig.shield
```kconfig
osource "c:/Users/sylve/OneDrive/Bureau/Telemtetry-for-the-Formula-Student/Software/shell/boards/shields/*/Kconfig.shield"
osource "C:/ncs/v2.4.0/nrf/boards/shields/*/Kconfig.shield"
```

## Software/nrf7002-bsd-sockets-example-main/build/Kconfig/Kconfig.shield.defconfig
```kconfig
osource "c:/Users/sylve/OneDrive/Bureau/Telemtetry-for-the-Formula-Student/Software/shell/boards/shields/*/Kconfig.defconfig"
osource "C:/ncs/v2.4.0/nrf/boards/shields/*/Kconfig.defconfig"
```
