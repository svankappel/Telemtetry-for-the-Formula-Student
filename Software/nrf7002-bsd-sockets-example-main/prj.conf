## prj.conf
```kconfig
 #! @file prj.conf
 #* @brief Global configurations for the project
 #
 # @author A BLUE THING IN THE CLOUD S.L.U.
 #    ===  When the technology becomes art ===
 #
 # http://abluethinginthecloud.com
 # j.longares@abluethinginthecloud
 #
 # (c) A BLUE THING IN THE CLOUD S.L.U.
 #
 #
 #
 #       ██████████████    ██    ██    ██  ██████    ██████████████
 #       ██          ██      ████████████████  ██    ██          ██
 #       ██  ██████  ██  ██████  ██    ██        ██  ██  ██████  ██
 #       ██  ██████  ██    ██████    ██      ██      ██  ██████  ██
 #       ██  ██████  ██      ██      ████  ██████    ██  ██████  ██
 #       ██          ██    ██      ██████    ████    ██          ██
 #       ██████████████  ██  ██  ██  ██  ██  ██  ██  ██████████████
 #                       ██████  ████  ██████  ████
 #       ██████  ██████████  ████    ████████      ████      ██
 #       ██  ████  ██    ██  ████        ████    ████████  ██    ██
 #           ██  ██  ████  ██      ██      ██      ██  ████  ██████
 #       ████  ████    ██      ██          ████  ██  ██        ██
 #           ██████████          ██      ██    ██  ████    ██  ████
 #         ██  ████    ██      ██████    ██  ██████████    ██    ██
 #       ██  ████  ████████████████  ██    ██        ████████  ████
 #               ████        ██  ██████  ██████████      ████  ██
 #       ██████  ████████████████    ████  ██    ██████    ██  ████
 #           ████████  ██████  ██    ██████      ██        ████  ██
 #       ██    ██  ████████  ██    ██        ██    ██          ████
 #         ████  ████          ██      ████████████  ██  ████  ██
 #       ██  ██████  ████  ██    ██      ████    ██████████
 #                       ██    ██████    ██      ██      ██  ██████
 #       ██████████████  ██  ██████  ██  ████  ████  ██  ████  ████
 #       ██          ██  ██      ████████  ██    ██      ████  ████
 #       ██  ██████  ██  ████  ██    ██████      ██████████    ████
 #       ██  ██████  ██    ██████    ██  ██  ████      ████  ██████
 #       ██  ██████  ██  ████      ██    ████  ██        ████    ██
 #       ██          ██  ██    ██      ██████████████  ██      ██
 #       ██████████████  ██████  ██        ██  ████    ██████  ████
 # 
CONFIG_WIFI=y
CONFIG_WIFI_NRF700X=y

# WPA supplicant
CONFIG_WPA_SUPP=y


#============================================================================#
# WiFi Stationing modifiable configurations

# CONFIG_STA_KEY_MGMT_NONE=y
CONFIG_STA_KEY_MGMT_WPA2=y
# CONFIG_STA_KEY_MGMT_WPA2_256=y
# CONFIG_STA_KEY_MGMT_WPA3=y
CONFIG_STA_SAMPLE_SSID="VRT-Telemetry"
CONFIG_STA_SAMPLE_PASSWORD="TJJC2233"

# Server's IPv4 Address
CONFIG_NET_CONFIG_PEER_IPV4_ADDR="x.x.x.x" 

# Board's IPv4 Address
CONFIG_NET_DHCPV4=y
# CONFIG_NET_CONFIG_MY_IPV4_ADDR="x.x.x.x" 
# CONFIG_NET_CONFIG_MY_IPV4_NETMASK="x.x.x.x" 
# CONFIG_NET_CONFIG_MY_IPV4_GW="x.x.x.x" 


#============================================================================#

# System settings
CONFIG_NEWLIB_LIBC=y
CONFIG_NEWLIB_LIBC_NANO=n

# Networking
CONFIG_NETWORKING=y
#CONFIG_POSIX_API=y
CONFIG_NET_LOG=y
CONFIG_NET_IPV4=y
CONFIG_NET_IPV6=n
CONFIG_NET_UDP=y
CONFIG_NET_TCP=y
CONFIG_NET_DHCPV4=y
CONFIG_NET_SOCKETS=y
CONFIG_NET_SOCKETS_POSIX_NAMES=y
CONFIG_NET_IF_UNICAST_IPV4_ADDR_COUNT=1
CONFIG_NET_MAX_CONTEXTS=10
CONFIG_NET_CONTEXT_SYNC_RECV=y

CONFIG_NET_PKT_RX_COUNT=16
CONFIG_NET_PKT_TX_COUNT=16

CONFIG_NET_MAX_CONN=10

# Below section is the primary contributor to SRAM and is currently
# tuned for performance, but this will be revisited in the future.
CONFIG_NET_BUF_RX_COUNT=80
CONFIG_NET_BUF_TX_COUNT=80
CONFIG_NET_CONTEXT_NET_PKT_POOL=y
CONFIG_NET_BUF_DATA_SIZE=128
CONFIG_HEAP_MEM_POOL_SIZE=153600
CONFIG_NET_TC_TX_COUNT=0



CONFIG_INIT_STACKS=y

CONFIG_NET_L2_ETHERNET=y

CONFIG_NET_CONFIG_SETTINGS=y

CONFIG_NET_SOCKETS_POLL_MAX=4

# Memories
CONFIG_MAIN_STACK_SIZE=4096
CONFIG_SYSTEM_WORKQUEUE_STACK_SIZE=4096
CONFIG_NET_TX_STACK_SIZE=4096
CONFIG_NET_RX_STACK_SIZE=4096

# Debugging
CONFIG_STACK_SENTINEL=y
CONFIG_DEBUG_COREDUMP=y
CONFIG_DEBUG_COREDUMP_BACKEND_LOGGING=y
CONFIG_DEBUG_COREDUMP_MEMORY_DUMP_MIN=y
CONFIG_SHELL_CMDS_RESIZE=n


# Kernel options
CONFIG_ENTROPY_GENERATOR=y

# Logging
CONFIG_LOG=y
CONFIG_LOG_BUFFER_SIZE=2048
CONFIG_POSIX_CLOCK=y

CONFIG_NET_MGMT_EVENT_STACK_SIZE=2048
CONFIG_PM=y

# Network driver configuration
CONFIG_TEST_RANDOM_GENERATOR=y

# Network address configuration
CONFIG_NET_CONFIG_NEED_IPV4=n 

# Building configuration
CONFIG_LED=y
CONFIG_TCP_SERVER=y
CONFIG_TCP_CLIENT=y
CONFIG_UDP_SERVER=y
CONFIG_UDP_CLIENT=y
CONFIG_WIFI_STATIONING=y

CONFIG_USERSPACE=n
```

## src/main.c
```c
/*! @file main.c
 * @brief Implementation of the wifi stationing 
 *
 * @author A BLUE THING IN THE CLOUD S.L.U.
 *    ===  When the technology becomes art ===
 *
 * http://abluethinginthecloud.com
 * j.longares@abluethinginthecloud
 *
 * (c) A BLUE THING IN THE CLOUD S.L.U.
 *
 *
 *
        ██████████████    ██    ██    ██  ██████    ██████████████
        ██          ██      ████████████████  ██    ██          ██
        ██  ██████  ██  ██████  ██    ██        ██  ██  ██████  ██
        ██  ██████  ██    ██████    ██      ██      ██  ██████  ██
        ██  ██████  ██      ██      ████  ██████    ██  ██████  ██
        ██          ██    ██      ██████    ████    ██          ██
        ██████████████  ██  ██  ██  ██  ██  ██  ██  ██████████████
                        ██████  ████  ██████  ████
        ██████  ██████████  ████    ████████      ████      ██
        ██  ████  ██    ██  ████        ████    ████████  ██    ██
            ██  ██  ████  ██      ██      ██      ██  ████  ██████
        ████  ████    ██      ██          ████  ██  ██        ██
            ██████████          ██      ██    ██  ████    ██  ████
          ██  ████    ██      ██████    ██  ██████████    ██    ██
        ██  ████  ████████████████  ██    ██        ████████  ████
                ████        ██  ██████  ██████████      ████  ██
        ██████  ████████████████    ████  ██    ██████    ██  ████
            ████████  ██████  ██    ██████      ██        ████  ██
        ██    ██  ████████  ██    ██        ██    ██          ████
          ████  ████          ██      ████████████  ██  ████  ██
        ██  ██████  ████  ██    ██      ████    ██████████
                        ██    ██████    ██      ██      ██  ██████
        ██████████████  ██  ██████  ██  ████  ████  ██  ████  ████
        ██          ██  ██      ████████  ██    ██      ████  ████
        ██  ██████  ██  ████  ██    ██████      ██████████    ████
        ██  ██████  ██    ██████    ██  ██  ████      ████  ██████
        ██  ██████  ██  ████      ██    ████  ██        ████    ██
        ██          ██  ██    ██      ██████████████  ██      ██
        ██████████████  ██████  ██        ██  ████    ██████  ████



*/


#include <zephyr/logging/log.h>
LOG_MODULE_REGISTER(sta, CONFIG_LOG_DEFAULT_LEVEL);

#include <zephyr/kernel.h>

#include "Task/Wifi_Stationing.h"
#include "Task/Led.h"
#include "Task/TCP_Server.h"
#include "Task/TCP_Client.h"
#include "Task/UDP_Server.h"
#include "Task/UDP_Client.h"
#include "Task/deviceInformation.h"

int main( void ) {

	Task_Wifi_Stationing_Init();
	Task_Toggle_Led_Init();
	Task_TCP_Client_Init();
	Task_TCP_Server_Init();
	Task_UDP_Client_Init();
	Task_UDP_Server_Init();

	k_sleep( K_FOREVER );
	
}
```
